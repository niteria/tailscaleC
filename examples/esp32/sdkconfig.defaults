## examples/esp32/sdkconfig.defaults
```kconfig
CONFIG_LWIP_NETIF_LOOPBACK=y
CONFIG_MBEDTLS_CHACHA20_C=y
CONFIG_MBEDTLS_POLY1305_C=y
CONFIG_MBEDTLS_CHACHAPOLY_C=y
CONFIG_MBEDTLS_HKDF_C=y
CONFIG_MBEDTLS_CERTIFICATE_BUNDLE=y
```

## examples/esp32_tailnet/sdkconfig.defaults
```kconfig
CONFIG_ETH_USE_OPENETH=y
CONFIG_MBEDTLS_CHACHA20_C=y
CONFIG_MBEDTLS_POLY1305_C=y
CONFIG_MBEDTLS_CHACHAPOLY_C=y
CONFIG_MBEDTLS_HKDF_C=y
CONFIG_MBEDTLS_CERTIFICATE_BUNDLE=y
CONFIG_ESP_MAIN_TASK_STACK_SIZE=24576
CONFIG_ESP_TASK_WDT_EN=n
```
